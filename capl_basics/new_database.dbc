VERSION ""

NS_ :

BS_:

BU_: obd

BO_ 256 msg1: 8 obd
 SG_ signal1 : 0|8@1- (1,0) [0|0] "" Vector__XXX

BA_DEF_  "BusType" STRING ;
BA_DEF_DEF_  "BusType" "CAN";
