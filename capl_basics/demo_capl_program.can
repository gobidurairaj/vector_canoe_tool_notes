/*@!Encoding:1252*/
includes
{
  
}

variables
{
  int i_var;
  byte b_var = 255;
  timer s_tmr;
  msTimer ms_tmr;
  message CAN1::LightState msg_ls;
}

on preStart
{
  i_var = 20;
  write("hello from preStart. initializing i_var to %d", i_var);
}

on start
{
  message 0x300 msg;
  msg.dlc = 8;
  msg.byte(0) = b_var;
  output(msg);
  write("hello from start.");
}

on timer s_tmr
{
  write("seconds timer expired");
  output(msg_ls);
}

on timer ms_tmr
{
  write("ms timer expired");
  msg_ls.FlashLight = 1;
  output(msg_ls);
}

on key 'a'
{
  setTimer(s_tmr, 20);
}
on key 'b'
{
  dword rtype;
  // setTimer(ms_tmr, 200);
  rtype = isTimerActive(s_tmr);
  write("s_tmr isTimerActive return value %d", rtype);
}

on preStop
{
  write("hello from preStop.");
}

on stopMeasurement
{
  write("hello from stopMeasurement.");
}